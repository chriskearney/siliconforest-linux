## Documentation/devicetree/bindings/phy/apple,t6030-atcphy-dp.yaml
```yaml
# SPDX-License-Identifier: (GPL-2.0-only OR BSD-2-Clause)
%YAML 1.2
---
$id: http://devicetree.org/schemas/phy/apple,t6030-atcphy-dp.yaml#
$schema: http://devicetree.org/meta-schemas/core.yaml#

title: Apple T6030 ATC PHY as a fixed DisplayPort transmitter

maintainers:
  - Sven Peter <sven@kernel.org>

description: >
  An Apple Type-C PHY (ATC) of the T6030 (M3 Pro) that a board wires as a
  fixed four-lane DisplayPort transmitter instead of a USB-C port, e.g. into
  the DP-to-HDMI converter of the MacBook Pro's HDMI port. It has no Type-C,
  USB or USB4 side: the only PHY it provides is the DisplayPort PHY, all four
  lanes on both of its lane pairs, up to HBR3.

  Powering the PHY up needs the device's calibration values, copied from
  Apple's device tree by the bootloader m1n1.

properties:
  compatible:
    const: apple,t6030-atcphy-dp

  reg:
    maxItems: 1

  reg-names:
    const: core

  "#phy-cells":
    const: 1
    description: The PHY type; only PHY_TYPE_DP exists.

  power-domains:
    maxItems: 1

  apple,tunable-dp-calibration:
    $ref: /schemas/types.yaml#/definitions/uint32-matrix
    items:
      items:
        - description: Register offset in the core region
        - description: Mask to be applied to the register value
        - description: Bits to be set after applying the mask
    description: >
      Calibration of the PHY's common block, PLL and AUX, in the order the
      bootloader copied it from Apple's device tree. Applied at every
      power-up while the PHY is held in reset.

required:
  - compatible
  - reg
  - reg-names
  - "#phy-cells"
  - power-domains

additionalProperties: false

examples:
  - |
    phy@3000000 {
      compatible = "apple,t6030-atcphy-dp";
      reg = <0x03000000 0x4c000>;
      reg-names = "core";
      #phy-cells = <1>;
      power-domains = <&ps_atc3_common>;
    };
```

## Documentation/devicetree/bindings/power/apple,t6030-pmp-ptd.yaml
```yaml
# SPDX-License-Identifier: (GPL-2.0-only OR BSD-2-Clause)
%YAML 1.2
---
$id: http://devicetree.org/schemas/power/apple,t6030-pmp-ptd.yaml#
$schema: http://devicetree.org/meta-schemas/core.yaml#

title: Apple T6030 PMP device-state requests (PTD)

maintainers:
  - Eryk Wieliczko <eryk@wieliczko.ninja>

description: |
  On T6030 the power management coprocessor (PMP) keeps a device-state
  table (PTD) in which the application processor requests SoC devices
  on and the PMP acknowledges them. A device whose PMGR power chain may
  only be powered after the PMP has acknowledged it, such as an external
  display coprocessor (DISPEXT0/1), lists this provider as a parent of
  the first domain of that chain. The specifier cell is the device's bit
  in the display request word (8 for DISPEXT0, 9 for DISPEXT1); powering
  it on requests that device together with DISP and ANS and waits for
  the acknowledgement. The request is retained once acknowledged.

allOf:
  - $ref: power-domain.yaml#

properties:
  compatible:
    const: apple,t6030-pmp-ptd

  reg:
    maxItems: 1

  "#power-domain-cells":
    const: 1

required:
  - compatible
  - reg
  - "#power-domain-cells"

additionalProperties: false

examples:
  - |
    soc {
        #address-cells = <2>;
        #size-cells = <2>;

        power-controller@3503c0000 {
            compatible = "apple,t6030-pmp-ptd";
            reg = <0x3 0x503c0000 0x0 0x14000>;
            #power-domain-cells = <1>;
        };
    };
```

## drivers/gpu/drm/Kconfig.siliconforest
```kconfig
# SPDX-License-Identifier: GPL-2.0-only OR MIT
config SILICONFOREST_NATIVE_GPU
	bool "SiliconForest native AGX GPU with maintained display stack"
	depends on ARM64 && ARCH_APPLE && EXPERT
	depends on !SILICONFOREST_M3
	help
	  Select the imported native AGX GPU driver and its matching userspace
	  ABI while retaining the maintained display, USB4, PHY and PMP drivers.
	  On T6030 the existing display gate links the GPU to this machine's PMP;
	  the native GPU obtains its AGX vote through that PMP's serialized bridge.
	  Requires native Mesa. Do not mix this ABI with compatibility Mesa.
	  Firmware, board, memory and command-stream admission remain enforced.
	  Default N until the complete pair has been qualified on the target.

config SILICONFOREST_M3
	bool "SiliconForest M3 retained-firmware stack (development only)"
	depends on ARM64 && ARCH_APPLE && EXPERT
	depends on !USB4
	help
	  Build the separately imported PR358/PR363 GPU, display, PHY and PMP
	  stack instead of the maintained implementations. Default N. This
	  is a source integration for J514S and J516C development, not a
	  hardware-qualified release. Requires matching boot-loader handoffs
	  and Mesa; J516C also needs its measured board-data firmware file.

	  USB4 is excluded because the imported display stack predates the
	  maintained tunnel ownership API. USB-C DP alternate mode is separate.
	  Use the DTBs under apple/m3-g15/, not the maintained board DTBs.
	  The retained coprocessor sessions have no safe unload/restart path.
	  Say N for a normal SiliconForest kernel.
```

## drivers/phy/apple/m3/Kconfig
```kconfig
# SPDX-License-Identifier: GPL-2.0 OR BSD-2-Clause
config PHY_APPLE_ATC
	tristate "Apple Type-C PHY"
	depends on (ARM64 && ARCH_APPLE) || (COMPILE_TEST && !GENERIC_ATOMIC64)
	depends on TYPEC
	depends on USB || !USB
	select GENERIC_PHY
	select APPLE_TUNABLE
	help
	  Enable this to add support for the Apple Type-C PHY found in
	  Apple Silicon M-series SoCs. This PHY supports USB2,
	  USB3, USB4, Thunderbolt, and DisplayPort.

	  If M is selected the module will be called 'phy-apple-atc'.

config PHY_APPLE_ATC_T6030_DP
	bool "Apple T6030 native DisplayPort on the Type-C PHY"
	depends on PHY_APPLE_ATC
	help
	  Drive DisplayPort alternate mode links on the USB-C ports of the
	  T6030 (M3 Pro): the display hold on the negotiated mode, AUX, the
	  link rates up to HBR3 and the drive levels, for its external
	  display controllers.

config PHY_APPLE_ATC_M3_KUNIT_TEST
	bool "KUnit tests for the Apple Type-C PHY" if !KUNIT_ALL_TESTS
	depends on PHY_APPLE_ATC && KUNIT
	depends on PHY_APPLE_ATC=m || KUNIT=y
	default KUNIT_ALL_TESTS
	help
	  Build the KUnit tests for the Type-C mux decisions of the Apple
	  Type-C PHY driver into the driver. They check how Type-C states
	  map to PHY modes and which mux updates may skip the lane and
	  PIPE work. The tests need no hardware and run when the driver
	  is loaded.

	  If unsure, say N.

config PHY_APPLE_DPTX
	tristate "Apple DPTX PHY"
	depends on ARCH_APPLE || COMPILE_TEST
	select GENERIC_PHY
	help
	  Enable this to add support for the Apple DPTX PHY found on Apple SoCs
	  such as the M2.
	  This driver provides support for DisplayPort and is used on the
	  Mac mini (M2 and M2 Pro, 2023).
```

## drivers/pmdomain/apple/Kconfig
```kconfig
# SPDX-License-Identifier: GPL-2.0-only

if ARCH_APPLE || COMPILE_TEST

config APPLE_PMGR_PWRSTATE
	bool "Apple SoC PMGR power state control"
	depends on PM
	select REGMAP
	select MFD_SYSCON
	select PM_GENERIC_DOMAINS
	select RESET_CONTROLLER
	help
	  The PMGR block in Apple SoCs provides high-level power state
	  controls for SoC devices. This driver manages them through the
	  generic power domain framework, and also provides reset support.

config APPLE_PMP_REPORT
	bool "Apple PMP report control"
	depends on OF
	depends on PM
	select PM_GENERIC_DOMAINS

config APPLE_PMP_T6030_PTD
	depends on SILICONFOREST_M3
	tristate "Apple T6030 PMP device-state power domains"
	depends on OF
	depends on PM
	depends on APPLE_PMP
	select PM_GENERIC_DOMAINS
	help
	  On T6030 (M3 Pro) the power management coprocessor (PMP) keeps a
	  device-state table in which the external display controllers must
	  be requested, and acknowledged, before their power domains are
	  powered. This provides that request as the parent power domain of
	  their power chains.

	  If built as a module, it is called pmp-ptd and cannot be unloaded.

config APPLE_PMC
	bool "Apple PMC voter interface"
	depends on OF
	depends on PM
	select PM_GENERIC_DOMAINS
	default ARCH_APPLE
	help
	  The PMC in some Apple SoCs arbitrates the performance states of
	  shared rails, such as the DRAM controller and the SoC fabric,
	  between voter agents. This driver enables the static agents and
	  provides power domains that enable a dynamic agent, such as the
	  GPU, while its device is powered on. It can also limit the DRAM
	  controller rail as a thermal cooling device.

config APPLE_PMC_KUNIT_TEST
	bool "KUnit tests for the Apple PMC voter interface" if !KUNIT_ALL_TESTS
	depends on APPLE_PMC && KUNIT=y
	default KUNIT_ALL_TESTS
	help
	  Unit tests for the Apple PMC driver. They check that enabling and
	  disabling a voter agent only changes that agent on each rail, and
	  that lifting a DCS limit gives the AP agent its own vote back. The
	  registers are simulated in memory. Only useful for kernel developers.

endif

config APPLE_PMP_REPORT_KUNIT_TEST
	tristate "Apple PMP report validation tests" if !KUNIT_ALL_TESTS
	depends on KUNIT && PM
	select PM_GENERIC_DOMAINS
	default KUNIT_ALL_TESTS
	help
	  Tests the PMP report layout, request acknowledgment flags and boot
	  argument validation without accessing hardware.
	  Includes malformed tables, address arithmetic and device ordering.
	  The PMP report driver does not need to be enabled to run this suite.
```
